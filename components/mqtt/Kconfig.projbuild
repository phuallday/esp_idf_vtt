## components/mqtt/Kconfig.projbuild
```kconfig
menu "MQTT Configuration"

    config BROKER
        string "MQTT BROKER"
        default "myssid"

endmenu
```

## components/qr_reader/Kconfig.projbuild
```kconfig
menu "QR Reader Configuration"

    config QR_READER_UART_PORT
        string "QR Reader UART Port"
        default "UART_NUM_2"
        help
            UART Port Number

endmenu
```
